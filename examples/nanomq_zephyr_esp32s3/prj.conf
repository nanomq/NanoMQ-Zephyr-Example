## CMakeLists.txt
```
# NanoMQ → ESP32-S3 broker example (sibling of examples/nanomq_zephyr_qemu_x86, the
# qemu_x86 version of the same app).
#
# Cross-compiles the NanoNNG submodule (nng/) with ExternalProject exactly
# like the NanoNNG zephyr_mqtt example does, then compiles the NanoMQ broker
# core sources (nanomq/nanomq/) against it.
#
# Board: esp32s3_devkitc/esp32s3/procpu — the ESP32-S3-LCD-EV-Board has no
# Zephyr board of its own; module differences (16 MB flash + PSRAM) are in
# boards/<target>.overlay.
#
# Build:  west build -b esp32s3_devkitc/esp32s3/procpu examples/nanomq_zephyr_esp32s3
#          (add:  -- -DEXTRA_CONF_FILE=local.conf   for Wi-Fi credentials)
# Flash:  west flash -d build/nanomq_zephyr_esp32s3

cmake_minimum_required(VERSION 3.20.0)
if(NOT DEFINED ZEPHYR_BASE)
  set(ZEPHYR_BASE $ENV{ZEPHYR_BASE})
endif()

# Board-specific device tree: ESP32-S3-LCD-EV-Board module differences
# (16 MB flash + 16 MB PSRAM) vs the esp32s3_devkitc default (N8, no
# PSRAM).  Named with Zephyr's shortened-board form, so it would normally
# be auto-discovered from boards/ — pulled in explicitly to be robust
# across Zephyr revisions' qualifier naming.
set(DTC_OVERLAY_FILE
  ${CMAKE_CURRENT_SOURCE_DIR}/boards/esp32s3_devkitc_procpu.overlay
  CACHE STRING "Board overlay: ESP32-S3-LCD-EV-Board module (N16R16V)" FORCE)

find_package(Zephyr REQUIRED HINTS ${ZEPHYR_BASE})
project(nanomq_zephyr_esp32s3)

# The nanomq checkout this example compiles against (NANOMQ_ROOT / NNG_ROOT).
# Fetched by scripts/fetch-nanomq.sh; override with -DNANOMQ_ROOT=/path.
include(${CMAKE_CURRENT_SOURCE_DIR}/../cmake/nanomq_dependency.cmake)

# ── NanoMQ broker core ──────────────────────────────────────────
# Mirror of the SOURCES list in nanomq/nanomq/CMakeLists.txt with three
# deviations:
#   * process.c excluded — pure POSIX (fork/kill/<paths.h>); its symbols
#     (process.h) are provided by src/process_stub.c instead.
#   * plugin/plugin.c excluded — NNG_ENABLE_PLUGIN off.
#   * tests/ excluded — NANOMQ_TESTS off.
target_sources(app PRIVATE
  src/main.c
  src/process_stub.c
  ${NANOMQ_ROOT}/nanomq/bridge.c
  ${NANOMQ_ROOT}/nanomq/pub_handler.c
  ${NANOMQ_ROOT}/nanomq/sub_handler.c
  ${NANOMQ_ROOT}/nanomq/unsub_handler.c
  ${NANOMQ_ROOT}/nanomq/hashmap.c
  ${NANOMQ_ROOT}/nanomq/rest_api.c
  ${NANOMQ_ROOT}/nanomq/web_server.c
  ${NANOMQ_ROOT}/nanomq/webhook_inproc.c
  ${NANOMQ_ROOT}/nanomq/webhook_post.c
  ${NANOMQ_ROOT}/nanomq/aws_bridge.c
  ${NANOMQ_ROOT}/nanomq/nanomq_rule.c
  ${NANOMQ_ROOT}/nanomq/conf_api.c
  ${NANOMQ_ROOT}/nanomq/cmd_proc.c
  ${NANOMQ_ROOT}/nanomq/acl_handler.c
  ${NANOMQ_ROOT}/nanomq/acl_hazard.c
  ${NANOMQ_ROOT}/nanomq/mqtt_api.c
  ${NANOMQ_ROOT}/nanomq/nanomq.c
  ${NANOMQ_ROOT}/nanomq/apps/broker.c
  ${NANOMQ_ROOT}/nanomq/apps/nng_bridge.c
)

target_include_directories(app PRIVATE
  ${NANOMQ_ROOT}/nanomq
  ${NANOMQ_ROOT}/nanomq/include
  ${NNG_ROOT}/include
)

# Upstream platform/capability macros (root CMakeLists.txt has no Zephyr
# branch and falls into the POSIX else-clause, so it is not reused here):
#   ACL_SUPP      — ENABLE_ACL default ON; conf struct fields follow it
#   ENABLE_LOG    — log calls enabled (SUPP_SYSLOG deliberately NOT set:
#                   Zephyr has no syslog(); nanolib log.c has __ZEPHYR__
#                   output support instead)
#   SUPP_NANO_LIB — hides nanomq.c's main(); keeps get_cache_argc/argv
#                   which rest_api.c references
#   NNG_STATIC_LIB — NNG_DECL decoration (imported lib carries no usage
#                   requirements)
target_compile_definitions(app PRIVATE
  ACL_SUPP
  ENABLE_LOG
  SUPP_NANO_LIB
  NNG_STATIC_LIB
  # nanolib's broker log_init(conf_log *) (mqtt_api.c) collides with the
  # Zephyr logging subsystem's log_init() once CONFIG_LOG=y (needed for
  # esp32 wifi driver diagnostics) — rename every app-side use so the two
  # keep separate symbols.
  log_init=nanomq_log_init
)

# NanoNNG broker-side protocol/transports (upstream sets these as plain
# variables before add_subdirectory(nng); ExternalProject needs them
# passed explicitly as cache vars).
set(NNG_EXTRA_ARGS
  -DNNG_PROTO_MQTT_BROKER=ON
  -DNNG_TRANSPORT_MQTT_BROKER_TCP=ON
  -DNNG_TRANSPORT_MQTT_BROKER_WS=ON
)

# ENABLE_LOG must reach the nng build as a compiler flag (nng's CMake
# only reacts to -DNNG_* cache vars): nanolib conf.c gates conf_log_init()
# on it and nanolib log.h compiles log_*() to no-ops without it — a
# libnng built without ENABLE_LOG leaves conf->log.type unset (broker
# logging dead) even though the app side defines it.
#
# ACL_SUPP likewise gates the conf_acl fields of struct conf
# (conf.h: #ifdef ACL_SUPP → conf_acl acl / acl_nomatch / acl_deny_action,
# 20 bytes).  It is defined on the app side above, so the conf.c compiled
# into libnng MUST see it too, or struct conf layouts disagree between
# libnng and the broker .c files — auth_http lands 20 bytes early in
# libnng's view and start_rest_server() locks a garbage
# auth_http.acl_cache_mtx (pthread_mutex_lock: Invalid argument → nni_panic).
#
# NNG_ZEPHYR_ALLOC_SMH switches the nng Zephyr allocator from libc malloc
# (SRAM-bounded) to the PSRAM-backed shared multi-heap — required on
# ESP32-S3, where internal SRAM (~512 KB) cannot hold the broker data
# plane.  See nng/src/platform/zephyr/zephyr_alloc.c.
set(NNG_EXTRA_CFLAGS "-DNNG_ZEPHYR_ALLOC_SMH -DENABLE_LOG -DACL_SUPP")

include(../cmake/nanonng_external.cmake)
```

## Kconfig
```
# NanoMQ broker example options
#
# An application-level Kconfig file replaces the top of the Zephyr tree
# (kconfig.cmake: KCONFIG_ROOT = <app>/Kconfig when it exists), so the
# whole Zephyr tree must be pulled back in explicitly.  See
# samples/basic/minimal/Kconfig for the same pattern.

config BROKER_LOG_DEBUG
	bool "Set NanoMQ log level to DEBUG"
	help
	  Bumps nanolib log level from the default WARN to DEBUG so the
	  MQTT session flow is visible on the console.  Disable for normal
	  runs (less noise, fewer cycles in log formatting).

config BROKER_REST_API
	bool "Enable the NanoMQ REST API (HTTP tcp:8081, Basic auth)"
	help
	  Sets conf http_server.enable / auth_type=BASIC plus the admin/public
	  credentials in main.c, so the broker serves /api/v4 over plain HTTP
	  behind Basic auth.

	  Basic over plain HTTP is base64, not encryption — TLS is compiled
	  out of the Zephyr NanoNNG.  Keep this off untrusted networks.

config BROKER_REST_USER
	string "REST API Basic-auth username"
	depends on BROKER_REST_API
	default ""
	help
	  Username for the REST API's Basic auth.  Deliberately no default:
	  the board serves this port to the whole LAN, so the API stays off
	  until a deployment supplies its own credentials.  Set both this and
	  BROKER_REST_PASS from local.conf (see local.conf.example).  The
	  published admin/public pair from etc/nanomq.conf is refused rather
	  than accepted.

config BROKER_REST_PASS
	string "REST API Basic-auth password"
	depends on BROKER_REST_API
	default ""
	help
	  Password matching BROKER_REST_USER.  Both must be set, and must not
	  be the published admin/public pair, for the listener to come up.

config BROKER_WEBHOOK
	bool "Enable the NanoMQ webhook forwarder (POST to BROKER_WEBHOOK_URL)"
	help
	  Sets conf web_hook.enable, an inproc hook channel (Zephyr has no IPC
	  transport) and two rules (MESSAGE_PUBLISH on "hook/#", CLIENT_CONNACK).
	  The receiver URL comes from BROKER_WEBHOOK_URL below; leave that empty
	  and the forwarder stays off.

config BROKER_WEBHOOK_URL
	string "Webhook receiver URL"
	depends on BROKER_WEBHOOK
	default ""
	help
	  Where the broker POSTs event JSON, e.g. "http://192.168.1.5:18080/".
	  Must be the LAN address of the machine running hook_receiver.py, and
	  reachable from the board.  Set it in local.conf (alongside the Wi-Fi
	  credentials) since it depends on your network:

	    CONFIG_BROKER_WEBHOOK=y
	    CONFIG_BROKER_WEBHOOK_URL="http://192.168.1.5:18080/"

config BROKER_WS
	bool "Enable the WebSocket listener (MQTT over RFC6455, tcp:8083)"
	help
	  Sets conf websocket.enable / websocket.url in main.c so the broker
	  also accepts MQTT over WebSocket on nmq-ws://0.0.0.0:8083/mqtt.
	  Requires the mqttws transport in the NanoNNG build (enabled by this
	  app's CMakeLists via NNG_TRANSPORT_MQTT_BROKER_WS=ON).  On the board
	  the listener is reached directly over Wi-Fi at the address DHCP
	  handed out — there is no SLIRP host forward here (that is the qemu
	  example).  TLS is built out of the Zephyr NanoNNG, so WSS stays inert.

config BROKER_WIFI_SSID
	string "Wi-Fi SSID (STA mode)"
	depends on WIFI_ESP32
	default ""
	help
	  SSID of the 2.4 GHz access point the example connects to.  Meant to be
	  set from a local, git-ignored conf file (see local.conf.example) so
	  real credentials never land in the tree.

config BROKER_WIFI_PSK
	string "Wi-Fi passphrase (STA mode; empty = open network)"
	depends on WIFI_ESP32
	default ""
	help
	  WPA2-PSK passphrase for BROKER_WIFI_SSID.  Empty selects an open
	  (unsecured) network.

source "Kconfig.zephyr"
```

## prj.conf
```kconfig
# NanoMQ broker → ESP32-S3 (esp32s3_devkitc/esp32s3/procpu) example config.
#
# Board: ESP32-S3-LCD-EV-Board with an ESP32-S3-WROOM-1-N16R16V module
# (16 MB flash + 16 MB octal PSRAM).  Derived from examples/nanomq_zephyr_qemu_x86/
# prj.conf (qemu_x86) — differences:
#   * QEMU/SLIRP/e1000/static-IP/X86-SSE bits dropped
#   * Wi-Fi STA + DHCPv4 added (native esp32 wifi driver, !SMP procpu)
#   * the broker data plane moves to the PSRAM-backed shared multi-heap
#     (see ESP_SPIRAM / ESP_SPIRAM_HEAP_SIZE here, the dts overlay under
#     boards/, and the NNG_ZEPHYR_ALLOC_SMH allocator in the nng submodule)
#   * feature surface trimmed: MQTT TCP + REST API + WebSocket; webhook and
#     the DEBUG log level stay off (the BROKER_* Kconfig switches are still
#     there — flip them on if PSRAM budget allows)
#
# Wi-Fi credentials are NOT here: BROKER_WIFI_SSID / BROKER_WIFI_PSK come
# from a local, git-ignored conf file (local.conf, see local.conf.example)
# so real SSID/passphrases never land in the tree.

# POSIX API — pthreads/sockets/poll for nng + NanoMQ.  Same Zephyr
# fixed-pool story as the qemu example: nng creates a mutex/condvar per
# sock/ctx/aio/work and retries forever when the pool is exhausted, so
# budget generously (1024 slots cost only ~30 KB of static arrays).
CONFIG_POSIX_API=y
CONFIG_POSIX_THREADS=y
CONFIG_POSIX_THREAD_THREADS_MAX=16
CONFIG_MAX_PTHREAD_MUTEX_COUNT=1024
CONFIG_MAX_PTHREAD_COND_COUNT=1024
# Rwlocks track distinct topics in the nanolib subscription tree (one per
# dbtree node); 256 covers the example scale.
CONFIG_MAX_PTHREAD_RWLOCK_COUNT=256
# nng taskq/poller threads and dynamic POSIX threads live on the kernel
# heap (k_malloc).  DYNAMIC_THREAD_STACK_SIZE is the per-pthread stack:
# 16 threads x 16 KB = 256 KB of the HEAP_MEM_POOL_SIZE budget below.
CONFIG_DYNAMIC_THREAD=y
CONFIG_DYNAMIC_THREAD_STACK_SIZE=16384
CONFIG_DYNAMIC_THREAD_ALLOC=y
CONFIG_POLL=y
# zvfs_poll() maps the whole poll() fd set onto one shared k_poll_event
# array (Kconfig default 3!); nng's pollq puts every armed socket into a
# single poll(), so budget one slot per listener/connection direction.
CONFIG_ZVFS_POLL_MAX=64

# Networking — the broker accepts MQTT over TCP on the Wi-Fi interface
CONFIG_NETWORKING=y
CONFIG_NET_IPV4=y
CONFIG_NET_TCP=y
CONFIG_NET_SOCKETS=y
CONFIG_NET_DHCPV4=y

# Wall clock: this board has no RTC, so time() reports uptime and every log
# line is stamped 1970-01-01.  main.c seeds CLOCK_REALTIME from an SNTP
# server once DHCP has bound (nanolib/log.c formats time(NULL), so a correct
# CLOCK_REALTIME is all the log timestamps need; see the port tutorial,
# Appendix A).
#
# This uses the public sntp_simple() rather than Zephyr's ready-made
# net_init_clock_via_sntp() helper: that helper lives in the net_config
# directory, which subsys/net/lib/CMakeLists.txt only adds to the build when
# CONFIG_NET_CONFIG_SETTINGS=y — and enabling that would pull in net_config's
# static-IP/auto-init module (whose AUTO_INIT defaults to *y*) just to
# compile the one file we want.  Our own seeding is ~25 lines and uses only
# public APIs.
#
# DNS is required because the servers are hostnames — sntp_simple() resolves
# them via getaddrinfo(), and the resolver only accepts literal addresses
# otherwise.  DNS_RESOLVER selects NET_SOCKETS_SERVICE (one more thread plus
# buffers); switch to literal IPv4 server addresses and drop this line if
# SRAM ever gets tight.
CONFIG_SNTP=y
CONFIG_DNS_RESOLVER=y

# Native ESP32 Wi-Fi (STA).  Driver requirements: the WIFI umbrella
# symbol, !SMP (the single-core procpu target), the espressif HAL blob
# module (fetch with `west blobs fetch hal_espressif` — without the
# blobs WIFI_ESP32 stays silently hidden), and &wifi enabled in the
# board dts (esp32s3_devkitc procpu does this).
CONFIG_WIFI=y
CONFIG_WIFI_ESP32=y
# Keep the STA bring-up in main.c deterministic (wait CONNECT_RESULT, then
# start the DHCPv4 client ourselves): with WIFI_STA_AUTO_DHCPV4=y (driver
# auto-selects it when DHCPv4 is on) the driver starts DHCP itself and
# never raises NET_EVENT_WIFI_CONNECT_RESULT — main.c would stall on the
# semaphore until its 30 s timeout.
CONFIG_WIFI_STA_AUTO_DHCPV4=n
# No driver-side auto-reconnect: the esp lib then loops inside CONNECTING
# and answers our next connect request with -EALREADY.  main.c retries
# with its own cadence instead.
CONFIG_ESP32_WIFI_STA_RECONNECT=n
# Move the Wi-Fi driver + net-stack static buffer pools (.noinit) into
# PSRAM (esp32s3 default.ld relocates those libs when this is on) —
# frees ~100 KB+ of internal SRAM at the cost of PSRAM-backed buffers.
CONFIG_ESP32_WIFI_NET_ALLOC_SPIRAM=y

# PSRAM (16 MB octal on the LCD-EV module; see the dts overlay under
# boards/).  The linker reserves a heap window of ESP_SPIRAM_HEAP_SIZE
# inside the PSRAM mapping and soc/espressif/common registers it as a
# shared multi-heap region (SMH_REG_ATTR_EXTERNAL); the nng allocator
# built with NNG_ZEPHYR_ALLOC_SMH (CMakeLists) serves the broker data
# plane from it — internal SRAM (~416 KB usable) cannot hold the broker.
CONFIG_ESP_SPIRAM=y
CONFIG_SPIRAM_MODE_OCT=y
# ESP_SPIRAM_SIZE normally mirrors the psram0 node's `size` in the dts
# (16 MB on this board — see boards/esp32s3_devkitc_procpu.overlay), but
# that Kconfig default is evaluated from an un-prompted dt-backed symbol
# that did not pick the app overlay up; set it explicitly (16777216 =
# 16 MB) so the linker's .ext_ram sizing/ASSERT matches the real part.
CONFIG_ESP_SPIRAM_SIZE=16777216
CONFIG_ESP_SPIRAM_HEAP_SIZE=4194304
CONFIG_ESP_SPIRAM_MEMTEST=y
CONFIG_SPIRAM_SPEED_80M=y
CONFIG_ESPTOOLPY_FLASHFREQ_80M=y
# Relocate whole libraries' .bss into PSRAM (.ext_ram.data): the Zephyr
# POSIX object pools (1024 mutexes + 1024 condvars + 256 rwlocks ≈ 60 KB)
# and the net_buf data pools only serve post-boot broker traffic, so they
# never need to live in the ~416 KB internal SRAM.
CONFIG_ESP_SPIRAM_BSS_RELOC_LIBS_AND_OBJS="libsubsys__portability__posix__options.a liblib__net_buf.a"

# Kernel heap (k_malloc): pthread stacks (16 x 16 KB worst case), the
# Wi-Fi driver allocation (adds HEAP_MEM_POOL_ADD_SIZE_ESP_WIFI on top)
# and Zephyr internals.  Static SRAM budget is ~416 KB (sram1) — tune
# against the linker map; broker data is NOT here (see PSRAM above).
# 192 KB leaves the rest of dram0_0_seg (currently ~97 % full at 256 KB)
# as headroom for the libc (picolibc sbrk) heap, which serves the raw
# malloc/calloc calls scattered through nanolib/nanomq (cJSON, REST
# buffers): at 256 KB pool that headroom was ~9 KB and any REST JSON
# would OOM.  Live pthread count is well under the 16-thread worst case
# (nng taskq is capped at 2 by the ExternalProject args), so the smaller
# pool only risks starving pthread_create if all 16 are up at once —
# raise it again if boot shows allocation failures.
CONFIG_HEAP_MEM_POOL_SIZE=196608
CONFIG_MAIN_STACK_SIZE=16384

# Net-stack pools — broker scale.  With ESP32_WIFI_NET_ALLOC_SPIRAM the
# packet/buffer pools live in PSRAM, so these are budget, not RAM.
CONFIG_NET_PKT_RX_COUNT=32
CONFIG_NET_PKT_TX_COUNT=32
CONFIG_NET_BUF_RX_COUNT=64
CONFIG_NET_BUF_TX_COUNT=64
# Every socket (listening or connected) takes one net_context + one
# net_conn; pool exhaustion makes Zephyr's TCP answer SYN with RST.
CONFIG_NET_MAX_CONTEXTS=32
CONFIG_NET_MAX_CONN=32
CONFIG_ZVFS_OPEN_ADD_SIZE_NET=32

CONFIG_PRINTK=y

# Float support in picolibc's printf: the REST API serialises numbers with
# cJSON, whose printer uses "%g" — without this, every numeric field comes
# out as the literal "*float*" and the JSON is unparseable.
CONFIG_PICOLIBC_IO_FLOAT=y

# NanoMQ HTTP REST API — conf http_server.enable + BASIC auth with the
# credentials from CONFIG_BROKER_REST_USER / _PASS (Kconfig BROKER_REST_API
# enables the listener).  Served on tcp:8081; conf_init defaults
# http_server.enable to false, so without this switch there is no listener on
# 8081.  Clients must send credentials:
#   curl -u admin:public http://<board-ip>:8081/api/v4/...
# The listener stays off until BROKER_REST_USER/PASS are set to credentials
# of your own in local.conf: they have no default, and the published
# admin/public pair is refused.  The board is on your LAN, so this is the
# only thing standing between the API and the network.
# Basic over plain HTTP is base64, not encryption — TLS is out of the
# Zephyr NanoNNG build.
CONFIG_BROKER_REST_API=y

# NanoMQ WebSocket listener (MQTT over RFC6455 on tcp:8083/mqtt), same
# surface as the qemu example: the mqttws transport is already in the
# NanoNNG build, and the functional suite's rest_get group asserts the
# runtime websocket conf mirrors the listener (as does the sibling
# qemu example).  webhook / DEBUG log stay off.
CONFIG_BROKER_WS=y
```

## src/main.c
```c
//
// Zephyr broker entry point — "embedded minimal conf" bootstrap.
//
// Zephyr has no filesystem, so the broker is started with conf_init()
// defaults plus a few field overrides, then broker() is called directly.
// broker_start() (file parsing, daemonize) is deliberately bypassed.
//
// Startup contract with apps/broker.c::broker(conf *):
//   * conf->url non-NULL  → broker listens on it (nmq-tcp:// ...)
//   * conf->ipc_internal  → cmd server over IPC transport; Zephyr build
//                           has NNG_TRANSPORT_IPC=OFF, so it must be false
//   * log_init() must run first: in the normal flow it is called by
//     broker_start_with_conf() right before broker(); broker() itself
//     never touches the nanolib log module
//   * broker() never returns: it parks in for(;;) nng_msleep(3600000)
//
#include <zephyr/kernel.h>
#include <zephyr/sys/printk.h>
#include <zephyr/net/net_if.h>
#include <zephyr/net/net_core.h>
#include <zephyr/net/sntp.h> // sntp_simple() — clock seed
#include <zephyr/sys/clock.h>

#if !defined(CONFIG_X86)
#include <string.h>
#include <zephyr/net/dhcpv4.h>
#include <zephyr/net/net_event.h>
#include <zephyr/net/wifi_mgmt.h>
#endif

#include "nng/nng.h"
#include "nng/supplemental/nanolib/conf.h"
#include "nng/supplemental/nanolib/log.h"
#include "mqtt_api.h" // log_init(conf_log *)

#include <time.h> // struct timespec/time_t — CMOS seed and SNTP seed

#if defined(CONFIG_X86)
#include <zephyr/sys/sys_io.h> // io_port_t
#include <zephyr/arch/x86/arch.h> // sys_in8()/sys_out8()
#endif

// broker() lives in nanomq/nanomq/apps/broker.c and is not declared in
// broker.h (which only exports broker_start/broker_start_with_conf).
extern int broker(conf *nanomq_conf);

#if defined(CONFIG_X86)
//
// Seed CLOCK_REALTIME from the QEMU-emulated mc146818 (CMOS) RTC.
//
// Zephyr has no timeprovider wired to the PC CMOS RTC, so CLOCK_REALTIME
// starts at the 1970 epoch and nanolib's log timestamps (log.c formats
// time(NULL) with localtime_r) print "1970-01-01 00:00:xx + uptime".
// QEMU's q35 chipset emulates the standard CMOS RTC at I/O ports 0x70/0x71
// and seeds it with the host clock at launch (default `-rtc base=utc`),
// so reading it once at boot and handing it to sys_clock_settime() gives
// real timestamps from then on (lib/os/clock.c: realtime = offset+uptime,
// so the clock keeps tracking without further updates).
//

#define CMOS_PORT_IDX   0x70U
#define CMOS_PORT_DAT   0x71U
#define CMOS_REG_SEC    0x00U
#define CMOS_REG_MIN    0x02U
#define CMOS_REG_HOUR   0x04U
#define CMOS_REG_DAY    0x07U
#define CMOS_REG_MON    0x08U
#define CMOS_REG_YEAR   0x09U
#define CMOS_REG_STAT_A 0x0AU
#define CMOS_REG_STAT_B 0x0BU
#define CMOS_UIP_BIT    0x80U /* STAT_A: update in progress */
#define CMOS_24H_BIT    0x02U /* STAT_B: 0 = 12 h mode */
#define CMOS_BIN_BIT    0x04U /* STAT_B: 0 = BCD, 1 = binary */

static uint8_t
cmos_read(uint8_t reg)
{
	// Bit 7 of the index byte disables NMI while addressing the RTC.
	sys_out8((uint8_t) (reg | 0x80U), CMOS_PORT_IDX);
	return sys_in8(CMOS_PORT_DAT);
}

static uint8_t
cmos_bcd2bin(uint8_t v)
{
	return (uint8_t) (((v >> 4) & 0x0FU) * 10U + (v & 0x0FU));
}

// days_from_civil(): Howard Hinnant's algorithm, proleptic Gregorian —
// avoids libc mktime()/TZ involvement (the CMOS clock is UTC).
static int64_t
days_from_civil(int64_t y, unsigned m, unsigned d)
{
	int64_t era;
	unsigned yoe, doe, doy;

	y -= (m <= 2U);
	era = (y >= 0 ? y : y - 399) / 400;
	yoe = (unsigned) (y - era * 400);
	doy = (153U * (m + (m > 2U ? -3U : 9U)) + 2U) / 5U + d - 1U;
	doe = yoe * 365U + yoe / 4U - yoe / 100U + doy;

	return era * 146097 + (int64_t) doe - 719468;
}

static int
cmos_read_datetime(uint8_t *secp, uint8_t *minp, uint8_t *hourp, uint8_t *dayp,
    uint8_t *monp, uint8_t *yearp)
{
	uint8_t s1, s2;
	int     i;

	// Re-read until the seconds register is stable across the whole
	// read (the RTC updates once per second; reads must not straddle it).
	for (i = 0; i < 8; i++) {
		s1    = cmos_read(CMOS_REG_SEC);
		*minp = cmos_read(CMOS_REG_MIN);
		*hourp = cmos_read(CMOS_REG_HOUR);
		*dayp = cmos_read(CMOS_REG_DAY);
		*monp = cmos_read(CMOS_REG_MON);
		*yearp = cmos_read(CMOS_REG_YEAR);
		s2    = cmos_read(CMOS_REG_SEC);
		if (s1 == s2) {
			*secp = s1;
			return (0);
		}
	}

	return (-1);
}

static void
seed_realtime_from_cmos(void)
{
	struct timespec ts;
	uint8_t sec, min, hour, day, mon, year, stat_b;
	bool binary, h24, pm = false;
	unsigned tries, y_full;
	int64_t epoch;

	// Wait out any update-in-progress cycle before touching the regs.
	for (tries = 0; tries < 1000; tries++) {
		if ((cmos_read(CMOS_REG_STAT_A) & CMOS_UIP_BIT) == 0U) {
			break;
		}
	}
	if (cmos_read_datetime(&sec, &min, &hour, &day, &mon, &year) != 0) {
		printk("rtc: CMOS read straddled an update, keeping 1970 epoch\n");
		return;
	}
	stat_b = cmos_read(CMOS_REG_STAT_B);
	binary = (stat_b & CMOS_BIN_BIT) != 0;
	h24    = (stat_b & CMOS_24H_BIT) != 0;

	// 12 h mode keeps the PM flag in bit 7 of the hour register.  Take it
	// off before the BCD conversion: cmos_bcd2bin(0x92) would otherwise
	// turn 12 PM into 92 and the range check below would reject it.
	if (!h24) {
		pm = (hour & 0x80U) != 0;
		hour &= 0x7FU;
	}

	if (!binary) {
		sec  = cmos_bcd2bin(sec);
		min  = cmos_bcd2bin(min);
		hour = cmos_bcd2bin(hour);
		day  = cmos_bcd2bin(day);
		mon  = cmos_bcd2bin(mon);
		year = cmos_bcd2bin(year);
	}
	if (!h24) {
		if (pm) {
			if (hour != 12U) {
				hour += 12U;
			}
		} else if (hour == 12U) {
			hour = 0;
		}
	}

	// Sanity checks: 2-digit year mapped onto 1970-2069, valid date.
	y_full = (year >= 70U) ? (1900U + year) : (2000U + year);
	if (y_full < 2000U || y_full > 2099U || mon < 1U || mon > 12U ||
	    day < 1U || day > 31U || hour > 23U || min > 59U || sec > 59U) {
		printk("rtc: CMOS time out of range (%04u-%02u-%02u %02u:%02u:%02u)\n",
		    y_full, mon, day, hour, min, sec);
		return;
	}
	epoch = days_from_civil(y_full, mon, day) * 86400 +
	    hour * 3600 + min * 60 + sec;

	ts.tv_sec  = (time_t) epoch;
	ts.tv_nsec = 0;
	(void) sys_clock_settime(SYS_CLOCK_REALTIME, &ts);

	printk("rtc: CMOS clock %04u-%02u-%02u %02u:%02u:%02u UTC, realtime seeded\n",
	    y_full, mon, day, hour, min, sec);
}
#endif // CONFIG_X86

static void
dump_iface_ipv4_cb(struct net_if *iface, struct net_if_addr *ifaddr, void *user_data)
{
	char buf[NET_IPV4_ADDR_LEN];

	// qemu example: NET_ADDR_MANUAL (static); ESP32-S3 example: NET_ADDR_DHCP.
	if (ifaddr->address.family == AF_INET &&
	    (ifaddr->addr_type == NET_ADDR_MANUAL || ifaddr->addr_type == NET_ADDR_DHCP)) {
		printk("net: ipv4 %s\n", net_addr_ntop(
			AF_INET, &ifaddr->address.in_addr, buf, sizeof(buf)));
	}
	ARG_UNUSED(iface);
	ARG_UNUSED(user_data);
}

static void
dump_iface_ipv4(struct net_if *iface)
{
	if (iface != NULL) {
		net_if_ipv4_addr_foreach(iface, dump_iface_ipv4_cb, NULL);
	}
}

static void
list_iface_cb(struct net_if *iface, void *user_data)
{
	const struct device *dev = net_if_get_device(iface);

	printk("net: iface %p dev=%s up=%d\n", (void *) iface,
	       dev == NULL ? "(null)" : dev->name, net_if_is_up(iface));
	if (user_data != NULL) {
		dump_iface_ipv4(iface);
	}
}

static void
dump_ifaces(void)
{
	net_if_foreach(list_iface_cb, (void *) 1);
}

#if defined(CONFIG_WIFI_ESP32)
//
// Wi-Fi STA + DHCPv4 bring-up (ESP32-S3 example; the qemu_x86 example has no
// Wi-Fi).  The broker binds 0.0.0.0 listeners, but there is nothing to
// accept connections from until the Wi-Fi link is up and has an IPv4
// address, so main() runs this before broker().
//
// Credentials come from app Kconfig (BROKER_WIFI_SSID / BROKER_WIFI_PSK)
// and are meant to be supplied through a local, git-ignored conf file
// (see local.conf.example) — real SSID/passphrases stay out of the tree.

static K_SEM_DEFINE(wifi_connected_sem, 0, 1);
static K_SEM_DEFINE(dhcp_bound_sem, 0, 1);

static void
wifi_mgmt_event_handler(struct net_mgmt_event_callback *cb, uint64_t mgmt_event,
    struct net_if *iface)
{
	switch (mgmt_event) {
	case NET_EVENT_WIFI_CONNECT_RESULT: {
		struct wifi_status *st = (struct wifi_status *) cb->info;

		if (st != NULL && st->status == 0) {
			printk("wifi: connected to \"%s\"\n", CONFIG_BROKER_WIFI_SSID);
			k_sem_give(&wifi_connected_sem);
		} else {
			printk("wifi: connect attempt failed (status %d)\n",
			    st == NULL ? -1 : st->status);
		}
		break;
	}
#if defined(CONFIG_NET_DHCPV4)
	case NET_EVENT_IPV4_DHCP_BOUND:
		printk("wifi: IPv4 address assigned (DHCPv4)\n");
		k_sem_give(&dhcp_bound_sem);
		break;
#endif
	default:
		break;
	}
	ARG_UNUSED(cb);
	ARG_UNUSED(iface);
}

static int
wifi_sta_connect(void)
{
	const char *ssid = CONFIG_BROKER_WIFI_SSID;
	const char *psk  = CONFIG_BROKER_WIFI_PSK;
	struct wifi_connect_req_params cnx = { 0 };
	struct net_mgmt_event_callback wifi_cb;
	struct net_mgmt_event_callback dhcp_cb;
	struct net_if *iface;
	int ret;

	if (ssid[0] == '\0') {
		printk("wifi: BROKER_WIFI_SSID is empty (set it via local.conf) — "
		    "starting broker without Wi-Fi\n");
		return (-1);
	}
	// Single Wi-Fi iface on this board — the default iface is it.
	iface = net_if_get_default();
	if (iface == NULL) {
		printk("wifi: no network interface found\n");
		return (-1);
	}

	cnx.ssid        = (const uint8_t *) ssid;
	cnx.ssid_length = strlen(ssid);
	cnx.channel     = WIFI_CHANNEL_ANY;
	cnx.band        = WIFI_FREQ_BAND_2_4_GHZ;
	cnx.security    = psk[0] != '\0' ? WIFI_SECURITY_TYPE_PSK : WIFI_SECURITY_TYPE_NONE;
	cnx.psk         = (const uint8_t *) psk;
	cnx.psk_length  = strlen(psk);
	cnx.timeout     = 30000U; /* ms — the wifi driver needs a finite timeout */

	/* One callback per event: net_mgmt's dispatch compares the whole
	 * layer-code field of mask vs event (subsys/net/ip/net_mgmt.c
	 * mgmt_run_slist_callbacks), so OR'ing events from different
	 * layer-codes into one mask silently drops every delivery. */
	net_mgmt_init_event_callback(&wifi_cb, wifi_mgmt_event_handler,
	    NET_EVENT_WIFI_CONNECT_RESULT);
	net_mgmt_add_event_callback(&wifi_cb);
#if defined(CONFIG_NET_DHCPV4)
	net_mgmt_init_event_callback(&dhcp_cb, wifi_mgmt_event_handler,
	    NET_EVENT_IPV4_DHCP_BOUND);
	net_mgmt_add_event_callback(&dhcp_cb);
#endif

	for (int tries = 1;; tries++) {
		printk("wifi: connecting to \"%s\" (attempt %d)\n", ssid, tries);
		ret = net_mgmt(NET_REQUEST_WIFI_CONNECT, iface, &cnx, sizeof(cnx));
		if (ret != 0) {
			printk("wifi: connect request failed (%d)\n", ret);
		}
		if (k_sem_take(&wifi_connected_sem, K_SECONDS(30)) == 0) {
			break;
		}
		printk("wifi: connect timed out — retrying (iface up=%d dormant=%d)\n",
		    net_if_is_up(iface), net_if_is_dormant(iface));
	}

#if defined(CONFIG_NET_DHCPV4)
	printk("wifi: connected — starting DHCPv4 client\n");
	net_dhcpv4_start(iface); // void on this Zephyr; outcome is the BOUND event
	if (k_sem_take(&dhcp_bound_sem, K_SECONDS(30)) != 0) {
		printk("wifi: no DHCPv4 lease within 30 s\n");
	}
#endif

	net_mgmt_del_event_callback(&wifi_cb);
#if defined(CONFIG_NET_DHCPV4)
	net_mgmt_del_event_callback(&dhcp_cb);
#endif
	return (0);
}
#endif /* CONFIG_WIFI_ESP32 */

#if defined(CONFIG_SNTP)
// Public NTP servers, tried in order.  sntp_simple() already retries with
// exponential backoff inside its own timeout (subsys/net/lib/sntp/
// sntp_simple.c), so a single call per server rides out a burst of lost
// packets; the second entry only covers the first server being down.
static const char *const sntp_servers[] = {
	"ntp.aliyun.com",
	"cn.pool.ntp.org",
};

// Seed CLOCK_REALTIME so that nanolib's log module (which formats
// time(NULL), log.c) stamps real dates instead of the 1970 epoch.  Best
// effort: with no server reachable the broker still starts, just with the
// wrong clock.  We roll this by hand instead of calling Zephyr's
// net_init_clock_via_sntp() because that lives in net_config, a directory
// only added to the build by CONFIG_NET_CONFIG_SETTINGS (see prj.conf; the
// time-source rationale is in the port tutorial).
static void
seed_realtime_from_sntp(void)
{
	// Two passes with a pause in between: the likeliest failure right
	// after DHCP binds is the resolver not being ready yet, and that
	// fails immediately rather than consuming the timeout.
	for (int pass = 0; pass < 2; pass++) {
		for (size_t i = 0; i < ARRAY_SIZE(sntp_servers); i++) {
			struct sntp_time ts;

			if (sntp_simple(sntp_servers[i], 2000, &ts) == 0) {
				// NTP fractions are in units of 1/2^32 s —
				// the same conversion Zephyr's own
				// net_init_clock_via_sntp() applies.
				struct timespec t = {
					.tv_sec  = (time_t) ts.seconds,
					.tv_nsec = (long)
					    (((uint64_t) ts.fraction *
					    NSEC_PER_SEC) >> 32),
				};

				(void) sys_clock_settime(
				    SYS_CLOCK_REALTIME, &t);
				printk("sntp: %s: epoch=%lld, realtime seeded\n",
				    sntp_servers[i], (long long) t.tv_sec);
				return;
			}
			printk("sntp: %s: no reply\n", sntp_servers[i]);
		}
		if (pass == 0) {
			k_msleep(1000);
		}
	}

	printk("sntp: no server reachable, clock stays at the 1970 epoch\n");
}
#endif /* CONFIG_SNTP */

void
main(void)
{
	conf *nmq_conf;

#if defined(CONFIG_X86)
	// Real wall clock before the broker (and nanolib log_init) starts
	// printing timestamps.
	seed_realtime_from_cmos();
#endif

	if ((nmq_conf = nng_zalloc(sizeof(conf))) == NULL) {
		printk("Cannot allocate configuration, quit\n");
		return;
	}

	conf_init(nmq_conf);


#if defined(CONFIG_WIFI_ESP32)
	// Wi-Fi first: the broker's 0.0.0.0 listeners are only reachable
	// once the link is up and DHCP has assigned an address.  qemu_x86
	// (the sibling example) takes the static-IP path in prj.conf instead.
	if (wifi_sta_connect() != 0) {
		printk("net: broker starting without a network interface\n");
	}
#endif

#if defined(CONFIG_SNTP)
	// Real wall clock before log_init()/broker() start printing
	// timestamps.  Must come after the Wi-Fi/DHCP wait above: SNTP needs a
	// route, an address and a working DNS resolver.
	seed_realtime_from_sntp();
#endif
	dump_ifaces();

	// Embedded minimal conf: defaults + key overrides.
	nmq_conf->url          = "nmq-tcp://0.0.0.0:1883";
	nmq_conf->ipc_internal = false; // cmd/reload server needs IPC transport
	nmq_conf->daemon       = false;
	// The QoS/keepalive/session machinery ticks on qos_duration (conf_init
	// default 10s): offline-queued QoS>0 messages only become eligible for
	// redelivery after qos_duration*1.25s (broker_tcp.c GET_QOS_RESEND) and
	// keepalive/session expiry are checked once per qos_duration.  Shorten
	// to 1s so persistent-session & keepalive scenarios respond promptly.
	nmq_conf->qos_duration = 1;
	// MQTT 5 topic aliases.  conf_init leaves max_topic_alias 0, so the
	// CONNACK advertises TOPIC_ALIAS_MAXIMUM=0 and every PUBLISH carrying a
	// topic alias is rejected (pub_handler.c handle_pub → "Invalid Topic
	// Alias ... Server Max allowed: 0").  The host test conf sets 1024
	// (.github/scripts/nanomq.conf on master); mirror it so the CI v5
	// suite's topic-alias case means the same thing here.
	nmq_conf->max_topic_alias = 1024;
#ifdef CONFIG_BROKER_LOG_DEBUG
	nmq_conf->log.level    = NNG_LOG_DEBUG;
#endif

#ifdef CONFIG_BROKER_REST_API
	// REST API on plain HTTP with Basic auth.  broker() calls
	// start_rest_server() itself (apps/broker.c); the http server is a
	// separate TCP listener (conf default ip 0.0.0.0, port 8081) bridged
	// into the broker socket over inproc REQ/REP.
	//
	// auth_type defaults to BASIC, but conf_http_server_init() leaves
	// username/password NULL — and basic_authorize() (rest_api.c) does
	// strlen() on both, so the credentials must be filled in or the first
	// REST request dereferences NULL.  They come from Kconfig
	// (BROKER_REST_USER/PASS), which has no default: the board serves this
	// port to the whole LAN, so the listener stays off until the
	// deployment supplies credentials of its own.  The published
	// admin/public pair is refused rather than warned about.
	//
	// NB: Basic over plain HTTP is base64, not encryption — TLS is
	// compiled out of the Zephyr NanoNNG, so keep this off untrusted
	// networks regardless.
	if ((strlen(CONFIG_BROKER_REST_USER) > 0) &&
	    (strlen(CONFIG_BROKER_REST_PASS) > 0) &&
	    !((strcmp(CONFIG_BROKER_REST_USER, "admin") == 0) &&
	        (strcmp(CONFIG_BROKER_REST_PASS, "public") == 0))) {
		nmq_conf->http_server.enable    = true;
		nmq_conf->http_server.auth_type = BASIC;
		nmq_conf->http_server.username =
		    nng_strdup(CONFIG_BROKER_REST_USER);
		nmq_conf->http_server.password =
		    nng_strdup(CONFIG_BROKER_REST_PASS);
		if ((nmq_conf->http_server.username == NULL) ||
		    (nmq_conf->http_server.password == NULL)) {
			// basic_authorize() (rest_api.c) strlen()s both, so a
			// copy that failed would crash the first request;
			// keep the listener off instead.
			printk("rest: credentials could not be copied, REST "
			    "API stays off\n");
			nmq_conf->http_server.enable = false;
		}
	} else {
		printk("rest: REST API stays off - set "
		    "CONFIG_BROKER_REST_USER and CONFIG_BROKER_REST_PASS to "
		    "credentials of your own (local.conf); the published "
		    "admin/public pair is refused\n");
	}
#endif

#ifdef CONFIG_BROKER_WS
	// WebSocket listener (MQTT over RFC6455, paho's default path /mqtt).
	// broker() listens on websocket.url verbatim — the CONF_WS_URL_DEFAULT
	// fallback lives in the broker_start*() file path, which this example
	// bypasses — so both fields must be set here.  TLS is compiled out of
	// the Zephyr NanoNNG, so the wss: sibling listener stays inert.
	nmq_conf->websocket.enable = true;
	nmq_conf->websocket.url    = "nmq-ws://0.0.0.0:8083/mqtt";
#endif

#ifdef CONFIG_BROKER_WEBHOOK
	// Webhook forwarder: broker pushes event JSON into the hook channel
	// and a dedicated thread POSTs it to web_hook.url with the nng HTTP
	// client (fire-and-forget; slow receivers never block the broker).
	// The default hook channel is ipc:///tmp/... — Zephyr has no IPC
	// transport (NNG_TRANSPORT_IPC=OFF), so it must be inproc.
	//
	// The receiver URL is a build-time setting (CONFIG_BROKER_WEBHOOK_URL)
	// and has no sensible default on a real board: it must be the LAN
	// address of the machine running hook_receiver.py, so set it in
	// local.conf alongside the Wi-Fi credentials.  With the URL left empty
	// the forwarder stays disabled rather than POSTing into the void.
	if (strlen(CONFIG_BROKER_WEBHOOK_URL) > 0) {
		// Every allocation here can fail and the rules are filled in field
		// by field, so build them first and only switch the forwarder on
		// once all of them succeeded.  nng_free(NULL, ...) is a no-op, so
		// the failure path can free unconditionally.
		conf_web_hook_rule *hook_msg =
		    nng_zalloc(sizeof(conf_web_hook_rule));
		conf_web_hook_rule *hook_conn =
		    nng_zalloc(sizeof(conf_web_hook_rule));
		conf_web_hook_rule **rules =
		    nng_zalloc(2 * sizeof(conf_web_hook_rule *));
		char *hook_topic = nng_strdup("hook/#");

		if (hook_msg != NULL && hook_conn != NULL && rules != NULL &&
		    hook_topic != NULL) {
			hook_msg->event  = MESSAGE_PUBLISH; // every publish
			hook_msg->topic  = hook_topic;
			hook_conn->event = CLIENT_CONNACK;  // every connect
			rules[0]         = hook_msg;
			rules[1]         = hook_conn;

			nmq_conf->web_hook.enable     = true;
			nmq_conf->web_hook.url =
			    nng_strdup(CONFIG_BROKER_WEBHOOK_URL);
			nmq_conf->hook_ipc_url =
			    nng_strdup("inproc://nanomq_hook");
			nmq_conf->web_hook.rules      = rules;
			nmq_conf->web_hook.rule_count = 2;
		} else {
			printk("webhook: allocation failed, forwarder stays off\n");
			nng_free(hook_msg, sizeof(conf_web_hook_rule));
			nng_free(hook_conn, sizeof(conf_web_hook_rule));
			nng_free(rules, 2 * sizeof(conf_web_hook_rule *));
			nng_free(hook_topic, sizeof("hook/#"));
		}
	}
#endif

#if defined(ENABLE_LOG)
	// Activate the nanolib log backend (console) and apply conf->log.level
	// — broker_start_with_conf() normally does this, but the embedded example
	// calls broker() directly.
	//
	// nanomq's log_init() (mqtt_api.c) applies log->level and registers the
	// console sink itself, since conf_init() defaults log.type to
	// LOG_TO_CONSOLE.  Registering one here as well would add a second sink
	// and print every line twice.
	//
	// Console at INFO by default: the board's boot sequence is short and
	// the DEBUG firehose buries it (the radio and net stack log at INFO,
	// the broker's per-packet tracing at DEBUG).  CONFIG_BROKER_LOG_DEBUG
	// raises it when that tracing is what you are after.
	nmq_conf->log.level = NNG_LOG_INFO;
#ifdef CONFIG_BROKER_LOG_DEBUG
	nmq_conf->log.level = NNG_LOG_DEBUG;
#endif
	(void) log_init(&nmq_conf->log);
	// print_conf() dumps every field of the conf at INFO, which is a dozen
	// lines of noise in front of the boot sequence -- keep it with the
	// DEBUG tracing it belongs to.
#ifdef CONFIG_BROKER_LOG_DEBUG
	print_conf(nmq_conf);
#endif
#endif



	broker(nmq_conf);

	// broker() only returns on (unreachable) test paths.
	printk("NanoMQ broker exited unexpectedly\n");
}
```
